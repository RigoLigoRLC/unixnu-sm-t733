## configs/gts7fewifi_defconfig
```kconfig
# The system kernel publishes the signed UFS volumes and mounts the RAM Data seed.
CONFIG_XNU_BUILD_ARCHIVES=y
CONFIG_XNU_SOURCE_CORECRYPTO14=y
CONFIG_XNU_SOURCE_PTHREAD=y
CONFIG_XNU_ARM_DT_PLATFORM=y
CONFIG_XNU_ARMCPU=y
CONFIG_XNU_NATIVE_ARCH_TIMER=y
CONFIG_XNU_NATIVE_PAN=y
CONFIG_XNU_DT_PANIC_REGION=y
# The seven early framebuffer patches are applied only when this option is enabled.
CONFIG_XNU_EARLY_ENTRY_MARKER=n
CONFIG_XNU_CRYPTO_BOOTSTRAP="prelinked"

CONFIG_XNU_NATIVE_UFS=y
# USB logging also retains process, page-table and SMP entry diagnostics.
CONFIG_XNU_NATIVE_USB_DEBUG=y
CONFIG_XNU_NATIVE_UFS_OWNER_ROOT=y
CONFIG_XNU_NATIVE_AES=y
CONFIG_XNU_NATIVE_RAM_BLOCK=y
CONFIG_XNU_NATIVE_VIRTIO_BLOCK=n
CONFIG_XNU_TRUST_CACHE_RUNTIME=y
CONFIG_XNU_NATIVE_CS_HASH_CACHE=y
CONFIG_XNU_VERIFIED_ROOT_PROVIDER=y
CONFIG_XNU_VERIFIED_ROOT_PROBE=n
CONFIG_XNU_OWNER_ROOT_AUDIT=y
CONFIG_XNU_OWNER_ROOT_TRUST=y
CONFIG_XNU_OWNER_CACHE_MOUNT=y
CONFIG_XNU_OWNER_CACHE_STARTUP=y
CONFIG_XNU_OWNER_BOOT_MANIFEST=y
CONFIG_XNU_OWNER_DATA_MOUNT=y
CONFIG_XNU_OWNER_UNION_SYSTEMOS=y
CONFIG_XNU_OWNER_CRYPTEX_FILES=n
CONFIG_XNU_NATIVE_AIR_INIT=n

CONFIG_XNU_OWNER_DATA_VOLUME_UUID="09A342FC-CB72-44DE-A10E-B89F14508869"
CONFIG_XNU_OWNER_CACHE_VOLUME_UUID="8846FE78-2910-4297-AF97-D59BB6F8FC16"
CONFIG_XNU_VERIFIED_ROOT_ARCHIVE="{tree}/build/verified-root/libVerifiedRoot.a"
CONFIG_XNU_NATIVE_AES_ARCHIVE="{tree}/build/native-aes/libNativeAES.a"
CONFIG_XNU_NATIVE_RAM_BLOCK_ARCHIVE="{tree}/build/native-ram-block/libNativeRamBlock.a"

CONFIG_XNU_SOURCE_MOCKFS=n
CONFIG_XNU_ARMVIRT_PLATFORM=n
CONFIG_XNU_NATIVE_ADRENO=n
CONFIG_XNU_NATIVE_LEGACY_DISPLAY=y
CONFIG_XNU_NATIVE_MOBILE_DISPLAY=n
CONFIG_XNU_SHENG_PMGR=y
CONFIG_XNU_BOOT_PROGRESS=n
CONFIG_XNU_EXTRA_LD_ARCHIVES="-Wl,-force_load,{tree}/build/t733-boot-log/libT733BootLog.a -Wl,-force_load,{tree}/build/t733-touch-input/libT733Touch.a -Wl,-force_load,{tree}/build/t733-battery/libT733Battery.a"
```
